// ==== OLED PANEL ====
// This code uses the u8g2lib for graphics to display on
// the 1.3" OLED panel operating on driver SH1106

#include <Arduino.h>
#include <U8g2lib.h>
#include <SoftwareSerial.h>
#include "ArduinoJson.h"

#ifdef U8X8_HAVE_HW_SPI
#include <SPI.h>
#endif
#ifdef U8X8_HAVE_HW_I2C
#include <Wire.h>
#endif

#define RX 50
#define TX 26

// Define unique bus tracker ID
#define UNIQUE_TRACKER_ID "busTrackerBT-1"

U8G2_SH1106_128X64_NONAME_1_HW_I2C u8g2(U8G2_R0, /* reset=*/ U8X8_PIN_NONE);

const int routeNameSize = 2;
String routeIds[routeNameSize] = {"qFJLN3NN2ebgEvjoDI1Y", "hF7nxVqJy7v8ADmBiIV0"};
StaticJsonDocument<200> routeIdKeyValue;

//SoftwareSerial master(RX, TX);

bool showSplashScreen = true;
bool openSelectionScreen = false;
bool showCurrentRouteInfoScreen = false;

//TODO: Get from mega
String currOperRoute = "Route 1";
//char *availableRoutes = ""; // routes separated by \n

// Define initial splash-screen bitmap
#define u8g2_logo_97x51_width 96
#define u8g2_logo_97x51_height 64
static const unsigned char u8g2_logo_97x51_bits[] U8X8_PROGMEM = {
  0x00, 0x00, 0x00, 0x00, 0x00, 0x00, 0x00, 0x00, 0x00, 0x00, 0x00, 0x00,
  0x00, 0x00, 0x00, 0x00, 0x00, 0x00, 0x00, 0x00, 0x00, 0x00, 0x00, 0x00,
  0x00, 0x00, 0x00, 0x00, 0x00, 0x00, 0x00, 0x00, 0x00, 0x00, 0x00, 0x00,
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  0x00, 0x00, 0x00, 0x00, 0x00, 0x00, 0x00, 0x00, 0x00, 0x00, 0x00, 0x00
};

char availableRoutes[] =
  "< Back\n"
  "Route 1\n"
  "Route 2\n"
  "Route 3\n"
  "Route 4\n"
  "Route 5\n"
  "Route 6\n"
  "Route 7";


uint8_t current_selection = 1;

void drawSelectionScreen() {

  current_selection = u8g2.userInterfaceSelectionList(
                        "ROUTES",
                        current_selection,
                        availableRoutes);

  String selection_str = u8x8_GetStringLineStart(current_selection - 1, availableRoutes);
  int firstIndex = selection_str.indexOf('\n');
  String selection_split = selection_str.substring(0, firstIndex);

  Serial.println(selection_split);
  if (selection_split == "< Back") {
    openSelectionScreen = false;
    showCurrentRouteInfoScreen = true;
    return;
  }

  uint8_t selectRoute = u8g2.userInterfaceMessage(
  "Selection:",
  u8x8_GetStringLineStart(current_selection - 1, availableRoutes ),
  "",
  " Ok \n Cancel ");

  if (selectRoute == 1) {
    if(selection_split != currOperRoute){
      Serial.println("not equal if");
      currOperRoute = selection_split;
  
      // Send new route to slave to post to firebase
      createAndSendToSlaveJSON(currOperRoute);
    }
    
    openSelectionScreen = false;
    showCurrentRouteInfoScreen = true;
    return;

  }
  else if (selectRoute == 2 && currOperRoute != "") {
    current_selection = 1;
    openSelectionScreen = true;
    showCurrentRouteInfoScreen = false;
    return;
  }
}

void drawCurrentRouteInfoScreen(String currRoute) {
  String routeString = "ROUTE " + currRoute;
  byte buffer[routeString.length() + 1];
  routeString.toCharArray(buffer, routeString.length() + 1);

  uint8_t btnSelected =  u8g2.userInterfaceMessage(
   "Operating on:",
   buffer,
   "",
   " Change ");

  if (btnSelected == 1) {
    current_selection =  1;
    openSelectionScreen = true;
    showCurrentRouteInfoScreen = false;
    return;
  }
}


// -----------------------------------------------------------------------------

void setup() {
  
  Serial.begin(9600);
  
  Wire.begin();
  
  // Begin graphics on OLED panel
  u8g2.begin(/* menu_select_pin= */ 5, /* menu_next_pin= */ 4,
    /* menu_prev_pin= */ 2, /* menu_up_pin= */ U8X8_PIN_NONE,
    /* menu_down_pin= */ U8X8_PIN_NONE, /* menu_home_pin= */ 3);


  for(int i = 0; i<routeNameSize; i++){
    routeIdKeyValue["Route " + String(i+1)] = routeIds[i];
  }
  
 
}


void loop() {
  unsigned int start = millis();
  u8g2.firstPage();
  do {
    if (showSplashScreen == true) {
      // Show Splash Screen
      u8g2.setFont(u8g2_font_ncenB14_tr);
      u8g2.drawXBMP(13, 0, u8g2_logo_97x51_width, u8g2_logo_97x51_height, u8g2_logo_97x51_bits);
      delay(50);
    } else {
      u8g2.setFont(u8g2_font_mercutio_basic_nbp_t_all);
      if (openSelectionScreen) {
        drawSelectionScreen();
      }
      else if (showCurrentRouteInfoScreen) drawCurrentRouteInfoScreen(currOperRoute);
    }

  } while ( u8g2.nextPage() );

  if (showSplashScreen) {
    showSplashScreen = false;
    showCurrentRouteInfoScreen = true;
  }
}

void createAndSendToSlaveJSON(String route){
  // Create the JSON document
  StaticJsonDocument<200> doc;
  doc["busRoute"] = routeIdKeyValue[route];
  
  char sendJSONData[500];
  serializeJson(doc, sendJSONData);
  
  Wire.beginTransmission(4);
  Wire.write(sendJSONData);
  Wire.endTransmission();
  
  Serial.println("Executed SENDJSON func");
}
